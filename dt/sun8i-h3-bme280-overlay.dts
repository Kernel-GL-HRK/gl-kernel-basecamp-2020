/dts-v1/;
/plugin/;

/ {
	compatible = "allwinner,sun8i-h3";

	fragment@0 {
		target-path = "/aliases";
		__overlay__ {
			bme280 = "/soc/i2c@1c2ac00/bme280@76";
		};
	};

	fragment@1 {
		target = <&i2c0>;
		__overlay__ {
			#address-cells = <1>;
			#size-cells = <0>;
			bme280@76 {
				compatible = "bme280";
				reg = <0x76>;
				status = "okay";
			};
		};
	};
};
