/dts-v1/;
/plugin/;

/ {

	fragment@0 {
		target = <&i2c1>;

		__overlay__ {
			#address-cells = < 0x01 >;
			#size-cells = < 0x00 >;
			world@69 {
				#address-cells = <1>;
				#size-cells = <0>;
				compatible = "hello,world";
				status = "ok";
				reg = <0x69>;
			};
		};
	};

};
